## build/conf/local.conf
```bitbake
MACHINE ??= "hd-rk3562-core"

DISTRO ?= "poky"
INIT_MANAGER = "systemd"

PACKAGE_CLASSES ?= "package_deb package_ipk"

EXTRA_IMAGE_FEATURES ?= "debug-tweaks"

USER_CLASSES ?= "buildstats"

WARN_QA:remove = "patch-fuzz"

PREFERRED_PROVIDER_trust-merger-native = "rk-binary-native"
PREFERRED_PROVIDER_loaderimage-native = "rk-binary-native"

PREMIRRORS:prepend = "\
git://.*/.* https://mirrors.ustc.edu.cn/yocto/git/ \n \
gitsm://.*/.* https://mirrors.ustc.edu.cn/yocto/git/ \n \
http://.*/.* https://mirrors.ustc.edu.cn/yocto/http/ \n \
https://.*/.* https://mirrors.ustc.edu.cn/yocto/https/ \n \
ftp://.*/.* https://mirrors.ustc.edu.cn/yocto/ftp/ \n \
"

MIRRORS += "\
git://.*/.* https://mirrors.ustc.edu.cn/yocto/git/ \n \
gitsm://.*/.* https://mirrors.ustc.edu.cn/yocto/git/ \n \
http://.*/.* https://mirrors.ustc.edu.cn/yocto/http/ \n \
https://.*/.* https://mirrors.ustc.edu.cn/yocto/https/ \n \
ftp://.*/.* https://mirrors.ustc.edu.cn/yocto/ftp/ \n \
"

CONF_VERSION = "2"
```

## meta-rk3562-custom/conf/layer.conf
```bitbake
# We have a conf and classes directory, add to BBPATH
BBPATH .= ":${LAYERDIR}"

BBFILES += "${LAYERDIR}/recipes-*/*/*.bb \
            ${LAYERDIR}/recipes-*/*/*.bbappend"

BBFILE_COLLECTIONS += "rk3562-custom"
BBFILE_PATTERN_rk3562-custom = "^${LAYERDIR}/"
BBFILE_PRIORITY_rk3562-custom = "10"

LAYERDEPENDS_rk3562-custom = "core rockchip-updateimg qt5-layer meta-python"
LAYERSERIES_COMPAT_rk3562-custom = "scarthgap"

# Skip very large Qt modules not needed on embedded targets
BBMASK += "meta-qt5/recipes-qt/qt5/qtwebkit"
BBMASK += "meta-qt5/recipes-qt/qt5/qtwebengine"
```

## meta-rk3562-custom/conf/machine/hd-rk3562-core.conf
```bitbake
#@TYPE: Machine
#@NAME: HD-RK3562-CORE
#@DESCRIPTION: Vanxak HD-RK3562-CORE module (LP4X + eMMC)

require conf/machine/include/rk3562-common.inc

MACHINE_FEATURES += "usbgadget"

# On-module eMMC boot (SD/MMC socket not populated on core module)
KERNEL_DEVICETREE = "rockchip/hd-rk3562-core.dtb"
UBOOT_MACHINE = "rk3562_defconfig"

# Root filesystem on eMMC GPT partition (must match wic part-name rootfs)
RK_UPDATEIMG_ROOTDEV = "PARTLABEL=rootfs"

IMAGE_ROOTFS_SIZE ?= "2097152"
IMAGE_ROOTFS_EXTRA_SPACE ?= "65536"
```

## meta-rk3562-custom/conf/machine/include/rk3562-common.inc
```bitbake
# Common configuration for HD-RK3562-CORE (self-contained, no meta-rockchip)

require conf/machine/include/arm/armv8a/tune-cortexa53.inc

TARGET_ARCH = "aarch64"
MACHINEOVERRIDES .= ":rockchip"

# Bootloader / kernel providers
PREFERRED_PROVIDER_virtual/bootloader = "u-boot-rockchip"
PREFERRED_PROVIDER_virtual/kernel = "linux-rockchip"
PREFERRED_VERSION_linux-rockchip ?= "6.6%"

# Rockchip SoC
RK_SOC_FAMILY = "rk3562"
RK_UBOOT_SPL = "1"
KBUILD_DEFCONFIG = "hd-rk3562-core_defconfig"
KBUILD_DEFCONFIGS = "rockchip_linux_defconfig rk3562.config"

# RK3562 U-Boot is AArch32-only (arch/arm); Linux runs AArch64.
UBOOT_ARCH = "arm"

# Rockchip fiq-debugger (ttyFIQ0) 默认 1500000；PC 串口工具须设相同波特率
SERIAL_CONSOLES = "1500000;ttyFIQ0"

# No virtual VT on headless core module; avoid respawning getty on missing /dev/tty1
USE_VT = "0"

# Kernel (aarch64)
KERNEL_IMAGETYPE = "Image"
ROCKCHIP_KERNEL_IMAGES = "1"
ROCKCHIP_KERNEL_COMPRESSED = "0"
LINUXLIBCVERSION = "6.6-custom%"
OLDEST_KERNEL = "${@d.getVar('LINUXLIBCVERSION').split('-')[0]}"

# Boot device / image layout
BOOT_DEVICE = "mmc"
UBOOT_SUFFIX = "img"
UBOOT_BINARY = "uboot.img"

WKS_FILE = "rk3562-gptdisk.wks.in"
RK_ROOTFS_TYPE = "ext4"
RK_ROOTFS_EXTRAOPTS = "-F -i 8192 -b 4096"
RK_ROOTDEV_UUID = "614e0000-0000-4b53-8000-1d28000054a9"
RK_PARTITION_GROW = "1"

MACHINE_EXTRA_RRECOMMENDS += "kernel-modules"

# Bypass patch QA noise from vendor trees
ERROR_QA:remove = "patch-status patch-fuzz"
WARN_QA:remove = "patch-fuzz"
```
